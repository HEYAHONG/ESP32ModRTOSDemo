## main/Kconfig.projbuild
```kconfig
menu "App config"

config GOLBAL_CONFIG_FILENAME
	string "Golbal Config FileName"
	default "config.json"


menuconfig WIFI_NETWORK
	bool "Enable WIFI network"
	default y

if  WIFI_NETWORK

source "$(PROJECT_PATH)/main/wifinetwork.Kconfig"

endif

menuconfig WIFI_MESH_NETWORK
	bool "Enable WIFI mesh network"
	default y
	depends on !WIFI_NETWORK

if WIFI_MESH_NETWORK

source "$(PROJECT_PATH)/main/wifimeshnet.Kconfig"

endif

menuconfig ETHERNET_NETWORK
        bool "Enable ethernet network"
        default n

if ETHERNET_NETWORK

source "$(PROJECT_PATH)/main/ethernet.Kconfig"

endif


menu "Network Protocols"

config LWIP_TFTPD_ON_BOOT
        bool "Start TFTPD  On Boot"
        default y
	depends on WIFI_MESH_NETWORK ||  WIFI_NETWORK

menuconfig NETWORK_PROTOCAL_MQTT
	bool "MQTT Client"
	default y
	depends on WIFI_MESH_NETWORK ||  WIFI_NETWORK

if  NETWORK_PROTOCAL_MQTT

source "$(PROJECT_PATH)/main/mqtt.Kconfig"

endif


endmenu

endmenu
```

## sdkconfig.defaults
```kconfig
CONFIG_PARTITION_TABLE_CUSTOM=y
CONFIG_PARTITION_TABLE_CUSTOM_FILENAME="partitions.csv"
CONFIG_PARTITION_TABLE_FILENAME="partitions.csv"
CONFIG_ESPTOOLPY_FLASHSIZE_4MB=y
CONFIG_ESPTOOLPY_FLASHSIZE="4MB"
CONFIG_SPI_FLASH_SIZE=0x400000
CONFIG_ESPTOOLPY_MONITOR_BAUD_115200B=y
CONFIG_ESP_CONSOLE_UART_BAUDRATE=115200
CONFIG_LWIP_DHCP_MAX_NTP_SERVERS=5
CONFIG_LWIP_LOCAL_HOSTNAME="esp32"
CONFIG_ESP32_DEFAULT_CPU_FREQ_240=y
CONFIG_ESP32_DEFAULT_CPU_FREQ_MHZ=240
CONFIG_ESPTOOLPY_FLASHMODE_QIO=y
CONFIG_ESPTOOLPY_FLASHFREQ_80M=y
CONFIG_ESPTOOLPY_FLASHFREQ="80m"
CONFIG_LWIP_L2_TO_L3_COPY=y
CONFIG_LWIP_IP_FORWARD=y
CONFIG_LWIP_IPV4_NAPT=y
CONFIG_LWIP_TCP_MSS=624
CONFIG_LWIP_TCP_OVERSIZE_MSS=y
```
